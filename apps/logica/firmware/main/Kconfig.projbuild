## apps/logica/firmware/main/Kconfig.projbuild
```kconfig
menu "P4OS logic analyser"

    choice LA_LINK
        prompt "Link to the host"
        default LA_LINK_USB_JTAG if SOC_USB_SERIAL_JTAG_SUPPORTED
        default LA_LINK_UART
        help
            The chip's own USB (USB-Serial-JTAG: the P4OS board sees it as
            usb0, a computer as a serial port), or UART0 (a dev board's
            USB-serial bridge, or wires to a header UART).

        config LA_LINK_USB_JTAG
            bool "USB-Serial-JTAG (the chip's own USB)"
            depends on SOC_USB_SERIAL_JTAG_SUPPORTED
        config LA_LINK_UART
            bool "UART0"
    endchoice

    config LA_UART_BAUD
        int "UART0 speed"
        depends on LA_LINK_UART
        default 921600

    config LA_PIN0
        int "Channel 0 GPIO"
        default 4 if IDF_TARGET_ESP32S3
        default 0
    config LA_PIN1
        int "Channel 1 GPIO"
        default 5 if IDF_TARGET_ESP32S3
        default 1
    config LA_PIN2
        int "Channel 2 GPIO"
        default 6 if IDF_TARGET_ESP32S3
        default 3 if IDF_TARGET_ESP32C3
        default 2
    config LA_PIN3
        int "Channel 3 GPIO"
        default 7 if IDF_TARGET_ESP32S3
        default 4 if IDF_TARGET_ESP32C3
        default 3
    config LA_PIN4
        int "Channel 4 GPIO"
        default 15 if IDF_TARGET_ESP32S3
        default 5 if IDF_TARGET_ESP32C3
        default 18
    config LA_PIN5
        int "Channel 5 GPIO"
        default 16 if IDF_TARGET_ESP32S3
        default 6 if IDF_TARGET_ESP32C3
        default 19
    config LA_PIN6
        int "Channel 6 GPIO"
        default 17 if IDF_TARGET_ESP32S3
        default 7 if IDF_TARGET_ESP32C3
        default 20
    config LA_PIN7
        int "Channel 7 GPIO"
        default 18 if IDF_TARGET_ESP32S3
        default 10 if IDF_TARGET_ESP32C3
        default 21

endmenu
```
