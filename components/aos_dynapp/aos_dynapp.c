/*
 * AmoledOS - Dynamic loading of applications.
 *
 * Apps are loaded **on demand**: at startup each .so is only opened far enough
 * to read its descriptor (name, icon, colour) and closed again. The code
 * enters RAM only when the user opens the app, and leaves when they close it.
 *
 * This is not an optimisation, it is the only thing that fits. The apps' .text
 * has to live in executable internal RAM, of which there is about 83 KB; the
 * six apps together add up to 134 KB. One at a time, on the other hand, is
 * plenty: the largest is 43 KB. Measured on the board.
 */
#include "aos_dynapp.h"
#include "aos_app.h"
#include "aos_ui.h"
#include "aos_i18n.h"
#include "aos_hal.h"

#include "esp_log.h"
#include "esp_timer.h"
#include "esp_heap_caps.h"
#include "esp_dlfcn.h"
#include "esp_app_desc.h"
#include "aos_icon_ops.h"
#include "private/elf_symbol.h"

#include <dirent.h>
#include <stdlib.h>
#include <string.h>
#include <sys/stat.h>
#include <time.h>
#include <stdio.h>

static const char *TAG = "aos_dynapp";

/* Where the apps' code runs. On the ESP32-S3 it is internal executable RAM
 * (a reservation, below) unless CONFIG_ELF_LOADER_TEXT_PSRAM_MMU maps PSRAM
 * pages on the instruction bus. On the ESP32-P4 data and instructions share
 * the PSRAM addresses, and the loader runs the code where it put it
 * (CONFIG_ELF_LOADER_LOAD_PSRAM): the P4 has no executable heap at all. */
#if CONFIG_ELF_LOADER_TEXT_PSRAM_MMU || (CONFIG_IDF_TARGET_ESP32P4 && CONFIG_ELF_LOADER_LOAD_PSRAM)
#define AOS_CODE_IN_PSRAM 1
#else
#define AOS_CODE_IN_PSRAM 0
#endif

/* How many microSD apps fit.
 *
 * It was at 16 and there were 17 .so files: the seventeenth was discarded by
 * returning false, WITHOUT A SINGLE LOG LINE, and from the other side it
 * looked like an app that simply did not show up in the menu. It is exactly
 * the same bug that had already happened in the simulator with MAX_SIM_APPS
 * (12 slots, 14 apps), so now it is 32 -like over there- and the limit also
 * SAYS SO when it fills up. Each slot is ~230 bytes of .bss, so they are
 * cheap, and they live in PSRAM anyway.
 *
 * It went from 32 to 48 when a module stopped meaning an app: lua.so declares
 * one app per .lua on the card, so 26 .so files can now be forty-something
 * entries. The ceiling has to be above what a card can hold, because the ones
 * that do not fit are whatever readdir happened to return last.
 *
 * Since v0.5.0 it is whatever the launcher leaves after the built-in apps'
 * reservation: 224 of 256. */
#define MAX_DYNAPPS     (AOS_MAX_APPS - AOS_BUILTIN_RESERVE)

/* The descriptor's strings point into the .so's rodata, which disappears when
 * it is closed: a copy of our own has to be kept. */
typedef struct {
    char  file[64];
    char  id[40];
    char  name[40];
    char  icon[16];

    aos_app_t loaded;       /* real callbacks, valid when handle != NULL */
    void     *handle;
    bool      pending_close;
    bool      in_use;

    /* Which app of the module this slot is. Zero for the 26 .so that bring
     * one app each, which is every one of them but lua.so. It is only used
     * to ask the module for the right descriptor when it is reopened: what
     * the app IS, is its id, and the module decides from there. */
    uint16_t  index;
} dynapp_t;

AOS_BSS_PSRAM static dynapp_t s_apps[MAX_DYNAPPS];
static int      s_count;

/* Table generated by tools/gen_symbols.py from the firmware's libraries. If it
 * has not been generated yet, it stays empty and the apps can only use the
 * libc and ESP-IDF symbols elf_loader already brings. */
extern const struct esp_elfsym aos_symbol_table[];

/* --------------------------------------------------------------------------
 * Where the loader gets its memory
 *
 * The component's esp_elf_malloc() asks for MALLOC_CAP_8BIT for everything
 * that is not code, and that lands in internal RAM. The problem is that
 * dlopen() reads the WHOLE file into memory before allocating the .text, so
 * the .so competes with itself for the single large internal block there is:
 *
 *     g2043:  57 KB of file + 43 KB of .text  against a 69 KB block
 *
 * The data does not need to be inside: it goes to PSRAM and internal RAM is
 * left whole for the code, which does have to be executable. It is intercepted
 * with -Wl,--wrap so as not to have to fork the component.
 * -------------------------------------------------------------------------- */
/* -----------------------------------------------------------------------------
 * Contiguous reservation for the apps' code
 *
 * Measured on the board: after opening and closing several apps the executable
 * heap was left with 54 KB free spread over 34 holes, the largest 32 KB. A
 * 45 KB app does not fit even though the total is there. The general heap
 * fragments because it mixes allocations of every size and lifetime.
 *
 * The way out is to set ONE large block aside at startup -when there is no
 * fragmentation yet- and serve the apps' .text from it. Since one app is open
 * at a time, that block fills and empties whole: it cannot be pulverised.
 *
 * The size has to be enough for the largest app without starving the rest.
 *
 * 2026-09-04: RAISING IT TO 80 KB WAS TRIED AND REVERTED.
 *
 * The reason for raising it turned out to be FALSE: it was believed that g2043
 * no longer fitted, comparing xtensa-esp-elf-size's "text" column (58,936 B)
 * against the 48 KB. But that column adds up the whole read-only segment
 * -.rodata, .dynsym, .dynstr, .rela, .hash-, and the loader allocates as
 * executable ONLY the .text section, which is 46,282 B. It fits, and the
 * fallback warning added in __wrap_esp_elf_malloc() did not fire once while
 * loading the 19 apps. To measure this the tool is
 * `xtensa-esp-elf-objdump -h`, not `size`.
 *
 * What was learned is that raising it is NOT free even when there is internal
 * RAM to spare, because it comes out of the same pool WiFi eats from. And that
 * free executable memory has to be looked at IN STEADY STATE, not eight
 * seconds after booting:
 *
 *     reservation 48 KB -> just booted 96.4 KB free, STEADY STATE 41.3 KB
 *     reservation 80 KB -> just booted 62.8 KB free, STEADY STATE  9.3 KB
 *
 * The extra 32 KB cost exactly 32: the mechanism works. But leaving free
 * executable memory at 9 KB is walking straight into the failure mode that
 * gives no warning.
 *
 * Where there IS room: the .so files are compiled without any -O (see the note
 * in HANDOFF-APPS.md section 5.5). With -Os g2043 drops to 28 KB, so the
 * reservation would go from being 94% full to 57% without touching a line of
 * the apps.
 *
 * If something does not fit in the reservation it falls back to the general
 * heap, which is still there, but NOW IT SAYS SO: a silent fallback is what
 * let the g2043 problem go unnoticed for months.
 * -------------------------------------------------------------------------- */

#define POOL_BYTES      (48 * 1024)
#define POOL_MAX_BLOCK  8               /* simultaneous modules, plenty */

static uint8_t *s_pool;
static struct {
    uint32_t off;
    uint32_t len;
    bool     used;
} s_pool_blk[POOL_MAX_BLOCK];

/* Only a build without CONFIG_ELF_LOADER_TEXT_PSRAM_MMU sets the reservation
 * aside (see aos_dynapp_scan()); with the option s_pool stays NULL and the
 * pool_* functions below answer "not ours". */
#if !AOS_CODE_IN_PSRAM
static void pool_init(void)
{
    if (s_pool) {
        return;
    }
    s_pool = heap_caps_malloc(POOL_BYTES, MALLOC_CAP_EXEC);
    if (!s_pool) {
        ESP_LOGW(TAG, "no contiguous reservation: the general heap is used");
        return;
    }
    ESP_LOGI(TAG, "code reservation: %u KB contiguous at %p",
             (unsigned)(POOL_BYTES / 1024), s_pool);
}
#endif

/* First hole that fits. With few large blocks nothing more is needed. */
static void *pool_alloc(uint32_t n)
{
    if (!s_pool || n > POOL_BYTES) {
        return NULL;
    }
    n = (n + 15u) & ~15u;               /* aligned to 16 */

    uint32_t cursor = 0;
    for (;;) {
        uint32_t fin = POOL_BYTES;
        int      choque = -1;

        /* how far the hole starting at 'cursor' reaches */
        for (int i = 0; i < POOL_MAX_BLOCK; i++) {
            if (s_pool_blk[i].used && s_pool_blk[i].off >= cursor &&
                s_pool_blk[i].off < fin) {
                fin = s_pool_blk[i].off;
                choque = i;
            }
        }
        if (fin - cursor >= n) {
            for (int i = 0; i < POOL_MAX_BLOCK; i++) {
                if (!s_pool_blk[i].used) {
                    s_pool_blk[i].off  = cursor;
                    s_pool_blk[i].len  = n;
                    s_pool_blk[i].used = true;
                    return s_pool + cursor;
                }
            }
            return NULL;                /* no free descriptor */
        }
        if (choque < 0) {
            return NULL;                /* no room left */
        }
        cursor = s_pool_blk[choque].off + s_pool_blk[choque].len;
    }
}

static bool pool_free(void *p)
{
    if (!s_pool || (uint8_t *)p < s_pool || (uint8_t *)p >= s_pool + POOL_BYTES) {
        return false;                   /* not ours */
    }
    uint32_t off = (uint32_t)((uint8_t *)p - s_pool);
    for (int i = 0; i < POOL_MAX_BLOCK; i++) {
        if (s_pool_blk[i].used && s_pool_blk[i].off == off) {
            s_pool_blk[i].used = false;
            return true;
        }
    }
    ESP_LOGE(TAG, "free of %p, which is not in the reservation", p);
    return true;                        /* ours all the same: it does not go to the heap */
}


/* State of the code reservation. Since it exists, the general executable heap
 * no longer reflects what the apps have available: the reservation shows as
 * occupied even when it is empty inside. Without this there is no way to look
 * at it. */
void aos_dynapp_pool_info(uint32_t *libre, uint32_t *mayor, int *usados)
{
    uint32_t ocupado = 0, mejor = 0, cursor = 0;
    int n = 0;

    if (!s_pool) {
        if (libre)  *libre  = 0;
        if (mayor)  *mayor  = 0;
        if (usados) *usados = -1;      /* -1 = there is no reservation */
        return;
    }

    for (int i = 0; i < POOL_MAX_BLOCK; i++) {
        if (s_pool_blk[i].used) {
            ocupado += s_pool_blk[i].len;
            n++;
        }
    }

    /* the largest contiguous hole, walking the reservation in order */
    for (;;) {
        uint32_t fin = POOL_BYTES;
        int choque = -1;
        for (int i = 0; i < POOL_MAX_BLOCK; i++) {
            if (s_pool_blk[i].used && s_pool_blk[i].off >= cursor &&
                s_pool_blk[i].off < fin) {
                fin = s_pool_blk[i].off;
                choque = i;
            }
        }
        if (fin - cursor > mejor) {
            mejor = fin - cursor;
        }
        if (choque < 0) {
            break;
        }
        cursor = s_pool_blk[choque].off + s_pool_blk[choque].len;
    }

    if (libre)  *libre  = POOL_BYTES - ocupado;
    if (mayor)  *mayor  = mejor;
    if (usados) *usados = n;
}

bool aos_dynapp_code_in_psram(void)
{
#if AOS_CODE_IN_PSRAM
    return true;
#else
    return false;
#endif
}

/* Set when one of the loader's allocations comes back empty: the dlopen
 * that follows failed for memory, not for a broken .so, and is worth
 * another try once memory is back (the scan, dyn_create). */
static bool s_oom;

static void *elf_malloc(uint32_t n, bool exec);

void *__wrap_esp_elf_malloc(uint32_t n, bool exec)
{
    void *p = elf_malloc(n, exec);
    if (!p) s_oom = true;
    return p;
}

static void *elf_malloc(uint32_t n, bool exec)
{
#if CONFIG_ELF_LOADER_TEXT_PSRAM_MMU
    /* RAM audit prototype: the code goes to PSRAM, 64 KB-aligned so that the
     * loader maps whole instruction-bus pages at it (esp_elf_esp32s3.c). The
     * internal reservation is not used at all. */
    if (exec) {
        void *p = heap_caps_aligned_alloc(0x10000, n, MALLOC_CAP_SPIRAM | MALLOC_CAP_8BIT);
        if (!p) {
            ESP_LOGE(TAG, "%u B of code: no PSRAM block", (unsigned)n);
        }
        return p;
    }
#elif AOS_CODE_IN_PSRAM
    /* ESP32-P4: the code in PSRAM on its own cache lines (128 B, L2), so
     * that writing it back and invalidating it never touches anyone else's
     * data. */
    if (exec) {
        void *p = heap_caps_aligned_alloc(128, (n + 127u) & ~127u, MALLOC_CAP_SPIRAM | MALLOC_CAP_8BIT);
        if (!p) {
            ESP_LOGE(TAG, "%u B of code: no PSRAM block", (unsigned)n);
        }
        return p;
    }
#endif
    if (exec) {
        void *p = pool_alloc(n);
        if (p) {
            return p;
        }
        /* Falling back to the general heap is not free: it is going back to
         * the scenario the reservation came to solve, and there a large app
         * fits or does not depending on how the fragmentation turned out. Let
         * it show in the log. */
        ESP_LOGW(TAG, "%u B of code did NOT fit in the reservation: going to the "
                      "general heap (free %u B, largest block %u B). If this "
                      "comes up often, the reservation is too small.",
                 (unsigned)n,
                 (unsigned)heap_caps_get_free_size(MALLOC_CAP_EXEC),
                 (unsigned)heap_caps_get_largest_free_block(MALLOC_CAP_EXEC));
        return heap_caps_malloc(n, MALLOC_CAP_EXEC);
    }
    void *p = heap_caps_malloc(n, MALLOC_CAP_SPIRAM | MALLOC_CAP_8BIT);
    return p ? p : heap_caps_malloc(n, MALLOC_CAP_8BIT);
}

/* The free has to be intercepted TOO: otherwise the loader would hand free() a
 * pointer that never came out of the heap. */
void __wrap_esp_elf_free(void *ptr)
{
    if (!ptr || pool_free(ptr)) {
        return;
    }
    heap_caps_free(ptr);
}


/* --------------------------------------------------------------------------
 * Symbol lookup
 *
 * Every undefined symbol of a .so is looked up here while it loads, at boot
 * for every module and again each time an app opens. The table has ~2,800
 * entries and was walked with strcmp from the top: a libc symbol like memcpy
 * -which is not in it- cost the whole walk before the loader's own table
 * even got asked. So the first scan sorts an index of pointers into it (in
 * PSRAM, ~11 KB) and the lookup is a binary search, a dozen comparisons.
 * Among duplicate names the first in the table still wins, as before.
 * -------------------------------------------------------------------------- */

static const struct esp_elfsym **s_sym_index;
static int      s_sym_count;
static int64_t  s_resolve_us;
static uint32_t s_resolve_calls;

static int sym_cmp(const void *a, const void *b)
{
    const struct esp_elfsym *x = *(const struct esp_elfsym *const *)a;
    const struct esp_elfsym *y = *(const struct esp_elfsym *const *)b;
    int c = strcmp(x->name, y->name);
    if (c) {
        return c;
    }
    return (x < y) ? -1 : (x > y);      /* the table's order among equals */
}

static void sym_index_build(void)
{
    if (s_sym_index) {
        return;
    }
    int n = 0;
    while (aos_symbol_table[n].name) {
        n++;
    }
    s_sym_index = heap_caps_malloc(sizeof(*s_sym_index) * (size_t)n,
                                   MALLOC_CAP_SPIRAM | MALLOC_CAP_8BIT);
    if (!s_sym_index) {
        return;                         /* the linear walk still works */
    }
    for (int i = 0; i < n; i++) {
        s_sym_index[i] = &aos_symbol_table[i];
    }
    qsort(s_sym_index, (size_t)n, sizeof(*s_sym_index), sym_cmp);
    s_sym_count = n;
}

static uintptr_t lookup_own(const char *name)
{
    if (!s_sym_index) {
        for (const struct esp_elfsym *sym = aos_symbol_table; sym->name; sym++) {
            if (strcmp(sym->name, name) == 0) {
                return (uintptr_t)sym->sym;
            }
        }
        return 0;
    }
    int lo = 0, hi = s_sym_count - 1;
    while (lo <= hi) {
        int mid = (lo + hi) / 2;
        int c = strcmp(s_sym_index[mid]->name, name);
        if (c == 0) {
            while (mid > 0 && strcmp(s_sym_index[mid - 1]->name, name) == 0) {
                mid--;
            }
            return (uintptr_t)s_sym_index[mid]->sym;
        }
        if (c < 0) {
            lo = mid + 1;
        } else {
            hi = mid - 1;
        }
    }
    return 0;
}

static uintptr_t resolver(const char *name)
{
    int64_t t = esp_timer_get_time();
    uintptr_t addr = lookup_own(name);
    if (!addr) {
        addr = elf_find_sym_default(name);
    }
    s_resolve_us += esp_timer_get_time() - t;
    s_resolve_calls++;
    return addr;
}

static dynapp_t *find_by_id(const char *id)
{
    for (int i = 0; i < s_count; i++) {
        if (s_apps[i].in_use && strcmp(s_apps[i].id, id) == 0) {
            return &s_apps[i];
        }
    }
    return NULL;
}

bool aos_dynapp_is_dynamic(const char *app_id)
{
    return app_id && find_by_id(app_id);
}

/* --------------------------------------------------------------------------
 * Opening and closing the .so
 * -------------------------------------------------------------------------- */

/* Opens the module and returns the aos_app_t its init() builds. */
/* The loader's dlopen() hands back the SAME module when it is already
 * loaded, with no count (elf_loader's dlmod_insert), and dlclose() unloads it
 * outright. A module with several apps (lua.so, python.so) is shared that
 * way: closing one of them took the code from under the other (seen on the
 * board going from one Python app to another: illegal instruction, pc == ra).
 * So every dlclose goes through here: the module is only unloaded when no
 * live app holds it (a handle not about to be closed), and then every entry
 * that pointed at it lets go. 'self' is the entry closing, or NULL.
 * Returns whether it was unloaded. */
static bool module_release(void *handle, dynapp_t *self)
{
    if (!handle) {
        return false;
    }
    for (int i = 0; i < s_count; i++) {
        dynapp_t *a = &s_apps[i];
        if (a != self && a->in_use && a->handle == handle && !a->pending_close) {
            ESP_LOGI(TAG, "%s stays loaded: %s still uses it", a->file, a->id);
            return false;
        }
    }
    dlclose(handle);
    for (int i = 0; i < s_count; i++) {
        dynapp_t *a = &s_apps[i];
        if (a != self && a->handle == handle) {
            a->handle = NULL;
            a->pending_close = false;
            memset(&a->loaded, 0, sizeof(a->loaded));
        }
    }
    return true;
}

#if AOS_CODE_IN_PSRAM
/* The big blocks of the PSRAM heap in address order, used and free, for
 * seeing what splits it (2026-11-08: 14 MB free and the largest block 9.4
 * MB, and a 5.5 MB app that did not fit). Collected under the heap's lock
 * into a buffer taken before, printed after. */
typedef struct { uint32_t off, size; bool used; } pblk_t;
typedef struct { pblk_t *b; int n, max; uintptr_t base; } pwalk_t;

static bool pwalk_cb(walker_heap_into_t heap, walker_block_info_t blk, void *user)
{
    pwalk_t *w = user;
    if (!w->base) w->base = (uintptr_t)heap.start;
    bool big = blk.used ? blk.size >= 256 * 1024 : blk.size >= 512 * 1024;
    if (big && w->n < w->max) {
        w->b[w->n].off = (uint32_t)((uintptr_t)blk.ptr - w->base);
        w->b[w->n].size = (uint32_t)blk.size;
        w->b[w->n].used = blk.used;
        w->n++;
    }
    return true;
}

static void psram_map_log(void)
{
    pwalk_t w = { .max = 48 };
    w.b = heap_caps_malloc(w.max * sizeof *w.b, MALLOC_CAP_SPIRAM);
    if (!w.b) return;
    heap_caps_walk(MALLOC_CAP_SPIRAM, pwalk_cb, &w);
    ESP_LOGW(TAG, "PSRAM blocks of 256 KB used or 512 KB free and up, by address:");
    for (int i = 0; i < w.n; i++)
        ESP_LOGW(TAG, "  +%5u KB  %5u KB  %s", (unsigned)(w.b[i].off / 1024), (unsigned)(w.b[i].size / 1024),
                 w.b[i].used ? "used" : "free");
    free(w.b);
}
#endif

static bool module_open(const char *filename, uint32_t index,
                        void **out_handle, aos_app_t *out_app)
{
    char relative[160];
    snprintf(relative, sizeof(relative), "/%s/%s", AOS_DYNAPP_RELATIVE, filename);

    /* Size and date of the file: without this there is no way to know whether
     * the SD has the freshly compiled .so or an old one, and every subsequent
     * diagnosis is left hanging. It happens more often than it seems. */
    {
        char full[192];
        snprintf(full, sizeof(full), "%s%s", CONFIG_BSP_SD_MOUNT_POINT, relative);
        struct stat st;
        if (stat(full, &st) == 0) {
            struct tm tm_buf;
            char cuando[24] = "?";
            localtime_r(&st.st_mtime, &tm_buf);
            strftime(cuando, sizeof(cuando), "%Y-%m-%d %H:%M", &tm_buf);
            ESP_LOGI(TAG, "  %s: %u bytes, modified %s",
                     filename, (unsigned)st.st_size, cuando);
        } else {
            ESP_LOGW(TAG, "  %s: could not read the size (%s)", filename, full);
        }
    }

#if AOS_CODE_IN_PSRAM
    /* the code goes to PSRAM: that is the memory to look at. A .so needs
     * about twice its size at once (the file read whole, then the image). */
    ESP_LOGI(TAG, "opening %s | PSRAM: free %u KB, largest block %u KB",
             filename,
             (unsigned)(heap_caps_get_free_size(MALLOC_CAP_SPIRAM) / 1024),
             (unsigned)(heap_caps_get_largest_free_block(MALLOC_CAP_SPIRAM) / 1024));
#else
    ESP_LOGI(TAG, "opening %s | executable: free %u B, largest block %u B | "
                  "internal: free %u B, largest block %u B",
             filename,
             (unsigned)heap_caps_get_free_size(MALLOC_CAP_EXEC),
             (unsigned)heap_caps_get_largest_free_block(MALLOC_CAP_EXEC),
             (unsigned)heap_caps_get_free_size(MALLOC_CAP_INTERNAL),
             (unsigned)heap_caps_get_largest_free_block(MALLOC_CAP_INTERNAL));
#endif

    s_oom = false;
    void *handle = dlopen(relative, RTLD_NOW);
    if (!handle) {
        ESP_LOGE(TAG, "dlopen(%s) failed: %s%s", relative, dlerror(), s_oom ? " (out of memory)" : "");
#if AOS_CODE_IN_PSRAM
        ESP_LOGW(TAG, "PSRAM after the failure: free %u KB, largest block %u KB",
                 (unsigned)(heap_caps_get_free_size(MALLOC_CAP_SPIRAM) / 1024),
                 (unsigned)(heap_caps_get_largest_free_block(MALLOC_CAP_SPIRAM) / 1024));
        if (s_oom) psram_map_log();
#else
        /* The map of the executable heap: it distinguishes "there is no
         * memory" from "there is, but in pieces". With 54 KB free and the
         * largest hole at 36 KB, a 45 KB app does not fit even though the
         * total is there. */
        ESP_LOGW(TAG, "--- blocks of the executable heap ---");
        heap_caps_dump(MALLOC_CAP_EXEC);
#endif
        return false;
    }

    /* Espressif's loader only indexes symbols of function type, which is why
     * the entry point is two functions and not a structure (see aos_app.h). */
    uint32_t (*abi_fn)(void)            = dlsym(handle, "aos_app_abi");
    bool     (*init_fn)(aos_app_t *app) = dlsym(handle, "aos_app_init");

    /* Optional, and only lua.so has them today: a module that brings several
     * apps (see aos_app.h). Without them the module has exactly one, which is
     * what every other .so on the card is. */
    bool (*init_at_fn)(aos_app_t *app, uint32_t index) =
        dlsym(handle, "aos_app_init_at");

    if (!abi_fn || !init_fn) {
        ESP_LOGE(TAG, "%s does not export aos_app_abi/aos_app_init", filename);
        module_release(handle, NULL);
        return false;
    }

    uint32_t abi = abi_fn();
    if (abi != AOS_ABI_VERSION) {
        ESP_LOGE(TAG, "%s uses ABI %u and the firmware expects %u: rebuild it",
                 filename, (unsigned)abi, (unsigned)AOS_ABI_VERSION);
        module_release(handle, NULL);
        return false;
    }

    memset(out_app, 0, sizeof(*out_app));
    bool ok = init_at_fn ? init_at_fn(out_app, index) : (index == 0 && init_fn(out_app));
    if (!ok) {
        ESP_LOGE(TAG, "%s failed to initialise app %u", filename, (unsigned)index);
        module_release(handle, NULL);
        return false;
    }

    *out_handle = handle;
    return true;
}


static void module_close(dynapp_t *app);

/* Second attempt when there is no executable memory.
 *
 * Two levels, and deliberately NEITHER evicts an active background app: if the
 * Recorder is recording, unloading it stops the recording without warning.
 * Failing with a message saying who is holding the memory is preferred.
 *
 *   1. Drain the pending closes. dyn_destroy() only marks; the real close
 *      happens on the next aos_dynapp_tick(). If the load is attempted before
 *      that tick, it fails with the memory one step away.
 *   2. Unload modules that were left loaded without being in use or being
 *      background ones. There should not be any; if one turns up, it is a bug
 *      and this papers over it -but leaves it noted in the log-. */
static bool liberar_ejecutable(const dynapp_t *excepto)
{
    bool libero = false;

    for (int i = 0; i < s_count; i++) {
        dynapp_t *a = &s_apps[i];
        if (!a->in_use || &s_apps[i] == excepto || !a->handle) {
            continue;
        }
        if (a->pending_close) {
            ESP_LOGW(TAG, "out of memory: closing %s early", a->file);
            a->pending_close = false;
            module_close(a);
            libero = true;
        }
    }
    return libero;
}

/* Who is holding memory, so we can tell the user. */
static const char *retenedor(void)
{
    for (int i = 0; i < s_count; i++) {
        if (s_apps[i].in_use && s_apps[i].handle) {
            return s_apps[i].name[0] ? s_apps[i].name : s_apps[i].file;
        }
    }
    return NULL;
}

static bool module_ensure_open(dynapp_t *app)
{
    if (app->handle) {
        app->pending_close = false;     /* it was reopened before being closed */
        return true;
    }
    if (module_open(app->file, app->index, &app->handle, &app->loaded)) {
        return true;
    }

    /* One retry, after recovering whatever can be recovered without breaking
     * anything. On the P4 the memory is PSRAM, and what holds it is mostly
     * the apps hidden in the background and the wallpaper photos: those go
     * (aos_ui_make_room), the hidden apps' modules with them. Called from
     * create(), with the UI's lock. */
    bool freed = false;
    if (s_oom && aos_ui_make_room() > 0) freed = true;
    if (liberar_ejecutable(app)) freed = true;
    if (freed && module_open(app->file, app->index, &app->handle, &app->loaded)) {
        ESP_LOGI(TAG, "%s loaded on the second attempt", app->file);
        return true;
    }
    return false;
}

static void module_close(dynapp_t *app)
{
    if (!app->handle) {
        ESP_LOGW(TAG, "closing %s with no handle: was it already unloaded?", app->file);
        return;
    }
    void *handle = app->handle;
    app->handle = NULL;
    memset(&app->loaded, 0, sizeof(app->loaded));
    if (!module_release(handle, app)) {
        return;
    }
    ESP_LOGI(TAG, "%s unloaded (executable free: %u B)", app->file,
             (unsigned)heap_caps_get_free_size(MALLOC_CAP_EXEC));
}

/* --------------------------------------------------------------------------
 * Trampolines: what the UI runtime sees
 * -------------------------------------------------------------------------- */

static void *dyn_create(aos_app_t *self, lv_obj_t *root)
{
    /* USB disk mode: the computer has the card, where the .so and its files
     * live (aos_usb_p4.c) */
    if (aos_hal_usb_card_away()) {
        aos_ui_toast(_("La computadora tiene la tarjeta.\nExpulsala ahí para volver a usar las apps."), 3000);
        return NULL;
    }
    dynapp_t *app = find_by_id(self->desc.id);
    if (!app || !module_ensure_open(app)) {
        /* Saying WHO is holding the memory: without that the user has no way
         * of knowing that closing another app solves it. */
        const char *quien = retenedor();
        char aviso[96];
        if (quien) {
            snprintf(aviso, sizeof(aviso),
                     _("Sin memoria.\n%s sigue en segundo plano:\ncerrala para liberar"),
                     quien);
        } else {
            snprintf(aviso, sizeof(aviso), "%s", _("No se pudo cargar la app"));
        }
        aos_ui_toast(aviso, 3000);
        return NULL;
    }
    return app->loaded.create ? app->loaded.create(self, root) : NULL;
}

static void dyn_destroy(aos_app_t *self, void *inst)
{
    dynapp_t *app = find_by_id(self->desc.id);
    if (!app) {
        ESP_LOGE(TAG, "destroy of '%s' but it is not in the table",
                 self->desc.id ? self->desc.id : "(no id)");
        return;
    }
    if (app->loaded.destroy) {
        app->loaded.destroy(self, inst);
    }
    /* The dlclose does NOT go here: the runtime deletes the LVGL objects after
     * this callback, and those objects may have callbacks living inside the
     * .so. It is closed on the next tick, with everything already deleted. */
    app->pending_close = true;
}

static void dyn_show(aos_app_t *self, void *inst)
{
    dynapp_t *app = find_by_id(self->desc.id);
    if (app && app->loaded.show) {
        app->loaded.show(self, inst);
    }
}

static void dyn_hide(aos_app_t *self, void *inst)
{
    dynapp_t *app = find_by_id(self->desc.id);
    if (app && app->loaded.hide) {
        app->loaded.hide(self, inst);
    }
}

static bool dyn_back(aos_app_t *self, void *inst)
{
    dynapp_t *app = find_by_id(self->desc.id);
    return (app && app->loaded.back) ? app->loaded.back(self, inst) : false;
}

static bool dyn_button(aos_app_t *self, void *inst, int action)
{
    dynapp_t *app = find_by_id(self->desc.id);
    return (app && app->loaded.button) ? app->loaded.button(self, inst, action) : false;
}

/* Without this trampoline every .so app was destroyed and created again when
 * the screen turned, its resize() never called. Created again within the same
 * tick, the module is not reloaded either, so an app whose statics only start
 * once (CAS's engine) came back broken. No resize() in the app: false, and the
 * runtime does that destroy + create as before. */
static bool dyn_resize(aos_app_t *self, void *inst, lv_obj_t *root)
{
    dynapp_t *app = find_by_id(self->desc.id);
    return (app && app->loaded.resize) ? app->loaded.resize(self, inst, root) : false;
}

static void dyn_tick(aos_app_t *self, void *inst)
{
    dynapp_t *app = find_by_id(self->desc.id);
    if (app && app->loaded.tick) {
        app->loaded.tick(self, inst);
    }
}

/* -------------------------------------------------------------------------- */

/* Where a scan's time goes, logged at its end (docs/APPS-P4.md, "Measured"). */
static struct {
    int64_t open_us;        /* dlopen + the probe's init() */
    int64_t lock_us;        /* waiting for the UI's lock */
    int64_t reg_us;         /* aos_ui_register_app itself */
} s_scan_cost;

/* Registers apps of one module, from index 'from' to the end, or only the
 * first when first_only. Returns how many were registered and, in *total,
 * how many the module declares.
 *
 * The UI's lock is taken once per batch and not once per app: at boot the
 * UI task is drawing, and every separate lock is a wait for its frame to
 * end. A module with many apps (lua.so) paid that wait once per script. */
#define REGISTER_BATCH  16

/* One app into the launcher: our own copies of its strings, the trampolines,
 * and the icon when it comes from the cache (from the .so, init() already
 * handed it over). The UI's lock is held across calls (*locked) and let go
 * every REGISTER_BATCH apps for a frame. */
static bool register_one(const char *filename, uint16_t index, const aos_app_desc_t *d,
                         const uint8_t *aic, size_t aic_len, bool *locked, int *in_batch)
{
    if (s_count >= MAX_DYNAPPS) {
        ESP_LOGE(TAG, "%s app %u does not fit: the limit is %d", filename, (unsigned)index, MAX_DYNAPPS);
        return false;
    }
    dynapp_t *slot = &s_apps[s_count];
    memset(slot, 0, sizeof(*slot));
    snprintf(slot->file, sizeof(slot->file), "%s", filename);
    snprintf(slot->id,   sizeof(slot->id),   "%s", d->id   ? d->id   : filename);
    snprintf(slot->name, sizeof(slot->name), "%s", d->name ? d->name : filename);
    snprintf(slot->icon, sizeof(slot->icon), "%s", d->icon ? d->icon : "");
    slot->index = index;

    aos_app_t stub = {0};
    stub.desc = *d;
    stub.desc.id   = slot->id;      /* pointing at OUR copies */
    stub.desc.name = slot->name;
    stub.desc.icon = slot->icon[0] ? slot->icon : NULL;

    stub.create  = dyn_create;
    stub.destroy = dyn_destroy;
    stub.show    = dyn_show;
    stub.hide    = dyn_hide;
    stub.back    = dyn_back;
    stub.button  = dyn_button;
    stub.resize  = dyn_resize;
    stub.tick    = dyn_tick;
    if (aic && aic_len) aos_icon_set_ops(&stub, aic, aic_len);

    slot->in_use = true;
    s_count++;

    int64_t t;
    if (!*locked) {
        t = esp_timer_get_time();
        *locked = aos_hal_lock(1000);
        s_scan_cost.lock_us += esp_timer_get_time() - t;
    }
    bool ok = false;
    if (*locked) {
        t = esp_timer_get_time();
        ok = aos_ui_register_app(&stub);
        s_scan_cost.reg_us += esp_timer_get_time() - t;
        if (++*in_batch >= REGISTER_BATCH) {
            aos_hal_unlock();       /* let a frame through */
            *locked = false;
            *in_batch = 0;
        }
    }
    if (!ok) {
        /* aos_ui_register_app says why in its own log line; this one
         * names the file, which is what tells you which .so to look at. */
        ESP_LOGE(TAG, "%s[%u] -> %s was refused by the launcher", filename, (unsigned)index, slot->id);
        slot->in_use = false;
        s_count--;
        return false;
    }
    ESP_LOGD(TAG, "registered %s[%u] -> %s (%s)", filename, (unsigned)index, slot->id, slot->name);
    return true;
}

static int register_apps(const char *filename, bool first_only, uint32_t *total)
{
    *total = 0;
    if (s_count >= MAX_DYNAPPS) {
        ESP_LOGE(TAG, "%s does not fit: the limit is %d dynamic apps and there are "
                      "already %d. Raise MAX_DYNAPPS or take a .so off the card",
                 filename, MAX_DYNAPPS, s_count);
        return 0;
    }

    int64_t t = esp_timer_get_time();
    void *handle = NULL;
    aos_app_t probe;
    if (!module_open(filename, 0, &handle, &probe)) {
        return 0;
    }
    s_scan_cost.open_us += esp_timer_get_time() - t;

    /* How many apps this module brings. Only lua.so answers; for everything
     * else the symbol is absent and the answer is one. The module stays open
     * for the whole loop: the alternative is a dlopen per app, and lua.so is
     * 144 KB. */
    uint32_t (*count_fn)(void) = dlsym(handle, "aos_app_count");
    bool (*init_at_fn)(aos_app_t *app, uint32_t index) =
        dlsym(handle, "aos_app_init_at");
    uint32_t n = (count_fn && init_at_fn) ? count_fn() : 1;
    if (n < 1) {
        n = 1;
    }
    *total = n;

    uint32_t from = first_only ? 0 : 1;
    uint32_t to   = first_only ? 1 : n;
    int registered = 0;
    bool locked = false;
    int in_batch = 0;

    for (uint32_t i = from; i < to; i++) {
        if (s_count >= MAX_DYNAPPS) {
            ESP_LOGE(TAG, "%s app %u does not fit: the limit is %d",
                     filename, (unsigned)i, MAX_DYNAPPS);
            break;
        }
        if (i > 0) {
            memset(&probe, 0, sizeof(probe));
            if (!init_at_fn(&probe, i)) {
                ESP_LOGE(TAG, "%s failed to describe app %u", filename, (unsigned)i);
                continue;
            }
        }

        if (!register_one(filename, (uint16_t)i, &probe.desc, NULL, 0, &locked, &in_batch)) continue;
        registered++;
    }
    if (locked) {
        aos_hal_unlock();
    }
    if (registered) {
        ESP_LOGI(TAG, "registered %s: %d app%s%s", filename, registered,
                 registered == 1 ? "" : "s", first_only && n > 1 ? " (more later)" : "");
    }

    /* descriptors read, the code goes away: it comes back in when it is opened
     * (unless one of its apps is open: a later scan of lua.so, say) */
    module_release(handle, NULL);
    return registered;
}

bool aos_dynapp_load(const char *filename)
{
    if (!filename) {
        return false;
    }
    /* One module arriving after boot: all of its apps, in the same two steps
     * as the scan. */
    uint32_t total = 0;
    if (register_apps(filename, true, &total) == 0) {
        return false;
    }
    if (total > 1) {
        register_apps(filename, false, &total);
    }
    return true;
}

/* --------------------------------------------------------------------------
 * Modules an app loads itself (aos_hal.h: aos_hal_module_open)
 *
 * An emulator's cores, one .so per console in the card's apps/<app>/: only
 * the one playing in memory, each with its licence, and a console added
 * without rebuilding the app. The same loader and resolver as the apps (the
 * firmware's table, the code in PSRAM), apart from the apps' own count
 * (module_release): the app opens and closes them.
 *
 * The loader keys its modules by the file's name without ".so": a core
 * named as a card app would be handed that app's module. Refused here.
 * -------------------------------------------------------------------------- */
struct aos_module {
    void *handle;
    char  name[48];
};

aos_module_t *aos_hal_module_open(const char *path, char *err, size_t errlen)
{
    if (err && errlen) err[0] = 0;
    if (!path || !*path) {
        if (err) snprintf(err, errlen, "%s", _("sin ruta"));
        return NULL;
    }
    /* the loader wants it from the card's root: "/apps/emulador/gba.so" */
    const char *rel = path;
    size_t mp = strlen(CONFIG_BSP_SD_MOUNT_POINT);
    if (!strncmp(rel, CONFIG_BSP_SD_MOUNT_POINT, mp) && rel[mp] == '/') rel += mp;
    const char *base = strrchr(rel, '/');
    base = base ? base + 1 : rel;
    size_t blen = strlen(base);
    if (blen < 4 || strcmp(base + blen - 3, ".so")) {
        if (err) snprintf(err, errlen, _("%s no es un .so"), base);
        return NULL;
    }
    for (int i = 0; i < s_count; i++) {
        if (s_apps[i].in_use && !strcmp(s_apps[i].file, base)) {
            if (err) snprintf(err, errlen, _("%s se llama como una app de la tarjeta: renombralo"), base);
            return NULL;
        }
    }
    aos_module_t *m = heap_caps_calloc(1, sizeof *m, MALLOC_CAP_SPIRAM);
    if (!m) {
        if (err) snprintf(err, errlen, "%s", _("sin memoria"));
        return NULL;
    }
    snprintf(m->name, sizeof m->name, "%.*s", (int)(blen - 3), base);
    char full[160];
    snprintf(full, sizeof full, "%s%s", rel[0] == '/' ? "" : "/", rel);
    m->handle = dlopen(full, RTLD_NOW);
    if (!m->handle) {
        if (err) snprintf(err, errlen, _("no se pudo cargar %s: %s"), base, dlerror());
        free(m);
        return NULL;
    }
    ESP_LOGI(TAG, "module %s opened by an app (%s)", m->name, full);
    return m;
}

void *aos_hal_module_sym(aos_module_t *m, const char *name)
{
    return m && m->handle && name ? dlsym(m->handle, name) : NULL;
}

void aos_hal_module_close(aos_module_t *m)
{
    if (!m) return;
    if (m->handle) {
        dlclose(m->handle);
        ESP_LOGI(TAG, "module %s closed (executable free: %u B)", m->name,
                 (unsigned)heap_caps_get_free_size(MALLOC_CAP_EXEC));
    }
    free(m);
}

bool aos_dynapp_unload(const char *app_id)
{
    dynapp_t *app = find_by_id(app_id);
    if (!app) {
        return false;
    }

    bool ok = false;
    if (aos_hal_lock(1000)) {
        ok = aos_ui_unregister_app(app_id);
        aos_hal_unlock();
    }
    if (ok) {
        module_close(app);
        app->in_use = false;
    }
    return ok;
}


/* Which modules are still loaded and how much executable memory they hold.
 *
 * An app with AOS_APP_FLAG_BACKGROUND is not destroyed on exit, so its .so
 * stays loaded until a restart. That is deliberate (the recorder has to go on
 * recording) but it is paid for in memory: PSRAM and MMU pages now, and until
 * v0.3.3 the internal reservation the code of ALL dynamic apps came from.
 * Without this list there is no way to know who is holding it. */
int aos_dynapp_loaded_list(char *out, size_t len)
{
    int n = 0;
    size_t used = 0;
    if (out && len) {
        out[0] = 0;
    }
    for (int i = 0; i < s_count; i++) {
        if (!s_apps[i].in_use || !s_apps[i].handle) {
            continue;
        }
        n++;
        if (out && used + 2 < len) {
            used += (size_t)snprintf(out + used, len - used, "%s%s",
                                     used ? " " : "", s_apps[i].file);
        }
    }
    return n;
}

void aos_dynapp_tick(void)
{
    for (int i = 0; i < s_count; i++) {
        if (s_apps[i].in_use && s_apps[i].pending_close) {
            s_apps[i].pending_close = false;
            module_close(&s_apps[i]);
        }
    }
}

static bool ends_with_so(const char *name)
{
    size_t len = strlen(name);
    return len > 3 && strcmp(name + len - 3, ".so") == 0;
}

/* --------------------------------------------------------------------------
 * The cache of the card's apps (2026-10-12)
 *
 * The scan used to dlopen() every .so only to read its descriptor: the whole
 * file read into PSRAM and relocated, init() called, closed again. With CAS
 * (5 MB, Giac inside) that one file cost 0.6-0.8 s of boot and a peak of
 * ~12 MB of PSRAM, and the small ones ~20 ms each. What init() leaves -the
 * descriptor and the icon it hands over (the apps' init does nothing else,
 * checked 2026-10-12)- goes into /data/apps.cache, and a .so whose name,
 * size and date match is registered from there without being opened. The
 * code is loaded when the app is opened, as before. Not cached: a module
 * with several apps (lua.so), whose list depends on the scripts on the card
 * and not on the .so. The whole cache belongs to one firmware (its ELF sha):
 * after an update every .so is opened once again.
 * -------------------------------------------------------------------------- */
#define CACHE_MAGIC     0x43505041u         /* "APPC" */
#define CACHE_VERSION   1
#define CACHE_AIC_MAX   512                 /* the apps' icons are 50-110 bytes */

typedef struct {
    char     file[64];
    uint32_t size, mtime;
    char     id[40], name[40], icon[16];
    int32_t  icon_vec;
    uint32_t color_a, color_b, flags;
    int32_t  order;
    uint16_t aic_len;
    uint8_t  aic[CACHE_AIC_MAX];
} cache_rec_t;

typedef struct {
    uint32_t magic, version;
    char     fw[24];                        /* the firmware's ELF sha */
    uint32_t count;
} cache_head_t;

static cache_rec_t *s_cache_old, *s_cache_new;
static int s_cache_old_n, s_cache_new_n;
static bool s_cache_dirty;
static bool s_cache_stale;      /* s_cache_old is another firmware's */

static void cache_path(char *out, size_t n)
{
    snprintf(out, n, "%s/apps.cache", aos_hal_path_data());
}

static void cache_fw(char *out, size_t n)
{
    memset(out, 0, n);
    esp_app_get_elf_sha256(out, n);
}

static void cache_load(void)
{
    s_cache_old = heap_caps_calloc(MAX_DYNAPPS, sizeof(cache_rec_t), MALLOC_CAP_SPIRAM);
    s_cache_new = heap_caps_calloc(MAX_DYNAPPS, sizeof(cache_rec_t), MALLOC_CAP_SPIRAM);
    s_cache_old_n = s_cache_new_n = 0;
    s_cache_dirty = false;
    s_cache_stale = false;
    if (!s_cache_old || !s_cache_new) return;
    char path[96];
    cache_path(path, sizeof path);
    FILE *f = fopen(path, "rb");
    if (!f) {
        s_cache_dirty = true;
        return;
    }
    cache_head_t h;
    char fw[24];
    cache_fw(fw, sizeof fw);
    if (fread(&h, sizeof h, 1, f) == 1 && h.magic == CACHE_MAGIC && h.version == CACHE_VERSION &&
        h.count <= MAX_DYNAPPS && fread(s_cache_old, sizeof(cache_rec_t), h.count, f) == h.count) {
        s_cache_old_n = (int)h.count;
        s_cache_stale = memcmp(h.fw, fw, sizeof fw) != 0;
    }
    if (!s_cache_old_n || s_cache_stale) {
        /* another firmware's records are only a last resort, for a .so the
         * scan could not open for lack of memory (aos_dynapp_scan) */
        ESP_LOGI(TAG, "apps cache: none for this firmware, every .so is opened once");
        s_cache_dirty = true;
    }
    fclose(f);
}

static const cache_rec_t *cache_find_any(const char *file, uint32_t size, uint32_t mtime);

static const cache_rec_t *cache_find(const char *file, uint32_t size, uint32_t mtime)
{
    return s_cache_stale ? NULL : cache_find_any(file, size, mtime);
}

static const cache_rec_t *cache_find_any(const char *file, uint32_t size, uint32_t mtime)
{
    for (int i = 0; i < s_cache_old_n; i++) {
        const cache_rec_t *r = &s_cache_old[i];
        if (!strcmp(r->file, file) && r->size == size && r->mtime == mtime) return r;
    }
    return NULL;
}

static void cache_keep(const cache_rec_t *r)
{
    if (s_cache_new && s_cache_new_n < MAX_DYNAPPS) s_cache_new[s_cache_new_n++] = *r;
}

/* What the dlopen just registered for a one-app module, for next time. */
static void cache_note(const char *file, uint32_t size, uint32_t mtime, const dynapp_t *slot)
{
    if (!s_cache_new || s_cache_new_n >= MAX_DYNAPPS) return;
    cache_rec_t *r = &s_cache_new[s_cache_new_n];
    memset(r, 0, sizeof *r);
    snprintf(r->file, sizeof r->file, "%s", file);
    r->size = size;
    r->mtime = mtime;
    snprintf(r->id, sizeof r->id, "%s", slot->id);
    snprintf(r->name, sizeof r->name, "%s", slot->name);
    snprintf(r->icon, sizeof r->icon, "%s", slot->icon);
    const aos_app_t *a = aos_ui_app_find(slot->id);
    if (!a) return;
    r->icon_vec = (int32_t)a->desc.icon_vec;
    r->color_a = a->desc.color_a;
    r->color_b = a->desc.color_b;
    r->flags = a->desc.flags;
    r->order = a->desc.order;
    size_t len = 0;
    const uint8_t *aic = aos_icon_app_ops(slot->id, &len);
    if (aic && len <= CACHE_AIC_MAX) {
        memcpy(r->aic, aic, len);
        r->aic_len = (uint16_t)len;
    }
    s_cache_new_n++;
    s_cache_dirty = true;
}

static void cache_save(void)
{
    if (s_cache_new && (s_cache_dirty || s_cache_new_n != s_cache_old_n)) {
        char path[96], tmp[104];
        cache_path(path, sizeof path);
        snprintf(tmp, sizeof tmp, "%s.part", path);
        FILE *f = fopen(tmp, "wb");
        if (f) {
            cache_head_t h = { CACHE_MAGIC, CACHE_VERSION, { 0 }, (uint32_t)s_cache_new_n };
            cache_fw(h.fw, sizeof h.fw);
            bool ok = fwrite(&h, sizeof h, 1, f) == 1 &&
                      fwrite(s_cache_new, sizeof(cache_rec_t), (size_t)s_cache_new_n, f) == (size_t)s_cache_new_n;
            ok = fclose(f) == 0 && ok;
            if (ok) {
                remove(path);
                ok = rename(tmp, path) == 0;
            }
            ESP_LOGI(TAG, "apps cache: %d app(s) written%s", s_cache_new_n, ok ? "" : " - FAILED");
        }
    }
    free(s_cache_old);
    free(s_cache_new);
    s_cache_old = s_cache_new = NULL;
}

static void cache_desc(const cache_rec_t *r, aos_app_desc_t *d)
{
    memset(d, 0, sizeof *d);
    d->id = r->id;
    d->name = r->name;
    d->icon = r->icon[0] ? r->icon : NULL;
    d->icon_vec = (aos_icon_id_t)r->icon_vec;
    d->color_a = r->color_a;
    d->color_b = r->color_b;
    d->flags = r->flags;
    d->order = r->order;
}

int aos_dynapp_scan(void)
{
    /* Before anything else: the reservation is asked for with the heap still
     * whole. The scan opens and closes each .so, and afterwards WiFi starts,
     * which takes some 35 KB of this same memory. Asking for it later would be
     * asking for it already fragmented, which is precisely what we want to
     * avoid. */
#if !AOS_CODE_IN_PSRAM
    pool_init();
#else
    ESP_LOGI(TAG, "apps' code runs from PSRAM: no internal reservation");
#endif

    int64_t ti = esp_timer_get_time();
    sym_index_build();
    ESP_LOGI(TAG, "symbol index: %d entries, %u ms", s_sym_count,
             (unsigned)((esp_timer_get_time() - ti) / 1000));
    elf_set_symbol_resolver(resolver);

    ESP_LOGI(TAG, "executable memory: %u B free, largest block %u B",
             (unsigned)heap_caps_get_free_size(MALLOC_CAP_EXEC),
             (unsigned)heap_caps_get_largest_free_block(MALLOC_CAP_EXEC));

    DIR *dir = opendir(AOS_DYNAPP_DIR);
    if (!dir) {
        ESP_LOGI(TAG, "there is no %s folder, no dynamic apps", AOS_DYNAPP_DIR);
        return 0;
    }

    /* The loader logs every symbol of every module at INFO: hundreds of lines
     * per .so, which is what made the 16 KB log ring forget the boot before
     * anyone could read it. Its warnings and errors still come through. */
    static const char *const LOUD[] = { "ELF", "DLMOD", "DLFCN", "elf_arch",
                                        "ELF_SYMBOL", "elf_s3mmu" };
    for (size_t i = 0; i < sizeof(LOUD) / sizeof(LOUD[0]); i++) {
        esp_log_level_set(LOUD[i], ESP_LOG_WARN);
    }

    /* Two passes. The first registers ONE app of every module; the second
     * the rest of the modules that declare several (lua.so, one app per
     * script). Before, readdir's order decided: with 200 scripts on the card
     * lua.so came before turbo.so, took the slots, and turbo and monsterhop
     * were the ones left out. A card full of scripts must never push a real
     * app out of the launcher. Timed, since every .so is opened here and this
     * is where a card with many apps costs boot time (docs/APPS-P4.md, "Measured"). */
    memset(&s_scan_cost, 0, sizeof(s_scan_cost));
    s_resolve_us = 0;
    s_resolve_calls = 0;
    int64_t t0 = esp_timer_get_time();
    enum { DEFERRED_MAX = 8, OOM_MAX = 8 };
    char deferred[DEFERRED_MAX][64];
    int n_deferred = 0;
    /* modules that could not be opened for lack of memory: once more at the
     * end, and from another firmware's cache if that fails too */
    struct { char file[64]; uint32_t size, mtime; } oom[OOM_MAX];
    int n_oom = 0;

    int loaded = 0;
    struct dirent *item;
    /* how many there are, for the boot screen's bar */
    int files = 0, seen = 0;
    while ((item = readdir(dir)) != NULL)
        if (item->d_name[0] != '.' && ends_with_so(item->d_name)) files++;
    rewinddir(dir);
    if (aos_hal_lock(1000)) {
        aos_ui_hold_home(true);
        aos_hal_unlock();
    }
    cache_load();
    int from_cache = 0, opened = 0;
    while ((item = readdir(dir)) != NULL) {
        if (item->d_name[0] == '.' || !ends_with_so(item->d_name)) {
            continue;
        }
        if (aos_hal_lock(1000)) {
            aos_ui_boot_progress(seen++, files + 1);
            aos_hal_unlock();
        }
        char full[192];
        snprintf(full, sizeof full, "%s/%s", AOS_DYNAPP_DIR, item->d_name);
        struct stat st;
        uint32_t size = 0, mtime = 0;
        if (stat(full, &st) == 0) {
            size = (uint32_t)st.st_size;
            mtime = (uint32_t)st.st_mtime;
        }
        /* described before, and not changed since: kept for the batch below */
        const cache_rec_t *hit = size ? cache_find(item->d_name, size, mtime) : NULL;
        if (hit) {
            cache_keep(hit);
            continue;
        }
        uint32_t total = 0;
        int before = s_count;
        if (register_apps(item->d_name, true, &total) > 0) {
            loaded++;
            opened++;
            if (total > 1 && n_deferred < DEFERRED_MAX) {
                snprintf(deferred[n_deferred++], sizeof(deferred[0]), "%s", item->d_name);
            }
            if (total == 1 && size && s_count == before + 1) cache_note(item->d_name, size, mtime, &s_apps[before]);
        } else if (s_oom && n_oom < OOM_MAX) {
            snprintf(oom[n_oom].file, sizeof oom[n_oom].file, "%.63s", item->d_name);
            oom[n_oom].size = size;
            oom[n_oom].mtime = mtime;
            n_oom++;
        }
    }
    closedir(dir);
    /* The PSRAM at boot is the most it will ever be, but the scan runs
     * beside the boot's own allocations (the home and lock photos decoded,
     * the radio, Bluetooth) and a big .so (cas.so, 5.3 MB: about 11 MB at
     * once) can land on a moment without a block for it (2026-11-08: the
     * app was simply missing from the home screen). Once more now; and if
     * it still does not fit, the record another firmware left (same file,
     * size and date) puts it on the home screen anyway, and its code is
     * loaded when it is opened, with the PSRAM of a quiet board. That record
     * is not carried into the new cache: the next boot opens it for real. */
    /* the photos split the PSRAM: they go for the retries, and the home
     * screen's is asked for again after them (the lock screen's comes back
     * when the screen locks) */
    bool room = false;
    if (n_oom && aos_hal_lock(1000)) {
        room = aos_ui_make_room() > 0;
        aos_hal_unlock();
    }
    for (int i = 0; i < n_oom; i++) {
        uint32_t total = 0;
        int before = s_count;
        ESP_LOGW(TAG, "%s: out of memory while scanning, trying again", oom[i].file);
        if (register_apps(oom[i].file, true, &total) > 0) {
            loaded++;
            opened++;
            if (total > 1 && n_deferred < DEFERRED_MAX) {
                snprintf(deferred[n_deferred++], sizeof(deferred[0]), "%.63s", oom[i].file);
            }
            if (total == 1 && oom[i].size && s_count == before + 1)
                cache_note(oom[i].file, oom[i].size, oom[i].mtime, &s_apps[before]);
            continue;
        }
        const cache_rec_t *r = oom[i].size ? cache_find_any(oom[i].file, oom[i].size, oom[i].mtime) : NULL;
        if (!r) {
            ESP_LOGE(TAG, "%s left out: no memory to describe it and no record of it", oom[i].file);
            continue;
        }
        aos_app_desc_t d;
        cache_desc(r, &d);
        bool locked = false;
        int in_batch = 0;
        if (register_one(r->file, 0, &d, r->aic, r->aic_len, &locked, &in_batch)) {
            loaded++;
            from_cache++;
            ESP_LOGW(TAG, "%s registered from an older cache record: it loads when opened", oom[i].file);
        }
        if (locked) aos_hal_unlock();
    }
    if (room && aos_hal_lock(1000)) {
        aos_ui_room_back();
        aos_hal_unlock();
    }
    /* the ones from the cache, in batches under one lock: nothing opened */
    {
        bool locked = false;
        int in_batch = 0;
        for (int i = 0; i < s_cache_new_n; i++) {
            const cache_rec_t *r = &s_cache_new[i];
            if (find_by_id(r->id)) continue;            /* opened above */
            aos_app_desc_t d;
            cache_desc(r, &d);
            if (register_one(r->file, 0, &d, r->aic, r->aic_len, &locked, &in_batch)) {
                loaded++;
                from_cache++;
            }
        }
        if (locked) aos_hal_unlock();
    }
    cache_save();
    ESP_LOGI(TAG, "apps: %d from the cache, %d opened to be described", from_cache, opened);
    int64_t t1 = esp_timer_get_time();

    for (int i = 0; i < n_deferred; i++) {
        uint32_t total = 0;
        register_apps(deferred[i], false, &total);
    }
    /* the home screen once, with every app in it */
    if (aos_hal_lock(2000)) {
        aos_ui_boot_progress(files, files + 1);
        aos_ui_hold_home(false);
        aos_hal_unlock();
    }
    int64_t t2 = esp_timer_get_time();

    ESP_LOGI(TAG, "scan: %d modules, %d apps, %u ms (modules %u ms, extra apps %u ms; "
                  "open %u, of it symbols %u for %u lookups; lock wait %u, register %u)",
             loaded, s_count, (unsigned)((t2 - t0) / 1000),
             (unsigned)((t1 - t0) / 1000), (unsigned)((t2 - t1) / 1000),
             (unsigned)(s_scan_cost.open_us / 1000), (unsigned)(s_resolve_us / 1000),
             (unsigned)s_resolve_calls, (unsigned)(s_scan_cost.lock_us / 1000),
             (unsigned)(s_scan_cost.reg_us / 1000));
    return loaded;
}
